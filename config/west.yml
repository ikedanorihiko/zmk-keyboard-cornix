## config/west.yml
```yaml
manifest:
  remotes:
    - name: zmkfirmware
      url-base: https://github.com/zmkfirmware
    - name: hitsmaxft
      url-base: https://github.com/hitsmaxft
    - name: englmaxi
      url-base: https://github.com/englmaxi
    - name: urob
      url-base: https://github.com/urob
    - name: janpfischer
      url-base: https://github.com/janpfischer

    - name: zmkfirmware
      url-base: https://github.com/zmkfirmware
    - name: prospector
      url-base: https://github.com/t-ogura
      
  projects:
    - name: zmk
      remote: zmkfirmware
      revision: main
#      revision: v0.2
      clone-depth: 1
      import:
        file: app/west.yml
    - name: zmk-helpers
      remote: urob
      revision: main
      clone-depth: 1
    #- name: zmk-rgbled-widget
    #  remote: hitsmaxft
    #  revision: main
    #  clone-depth: 1
    - name: zmk-dongle-display
      remote: englmaxi
      revision: main
      clone-depth: 1
    #- name: zmk-dongle-screen
    #  remote: janpfischer
    #  revision: main
    #  clone-depth: 1


    # Add this:
    - name: zmk
      remote: zmkfirmware
      revision: main
      import: app/west.yml
    - name: prospector-zmk-module
      remote: prospector
      revision: v2.2.1  # Use v2.0.0 for ZMK ≤0.3 (Zephyr 3.x)
      path: modules/prospector-zmk-module
      
  self:
    path: config
```
